## Kconfig
```kconfig
mainmenu "Dexatek Application Configuration"

source "library/Kconfig"
source "dexatek/Kconfig"
source "kenmec/Kconfig"
```

## dexatek/Kconfig
```kconfig
menu "dexatek"

config DEXATEK_APPLICATION
	bool "DEXATEK_APPLICATION"
	default y

endmenu
```

## kenmec/Kconfig
```kconfig
menu "Kenmec"

config KENMEC_APPLICATION
	bool "KENMEC_APPLICATION"
	default y

endmenu
```

## library/Kconfig
```kconfig
menu "library"

config LIBGPIO
	bool "libgpio"
	default y
	
config WPA_SUPPLICANT_RTW
	bool "wpa_supplicant_rtw"
	default y

config LIBMODBUS
	bool "Libmodbus-3.1.6"
	default y

config MDNS
	bool "mdns"
	default y

endmenu
```
